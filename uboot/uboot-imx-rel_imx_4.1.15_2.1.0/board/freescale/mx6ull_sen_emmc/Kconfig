## uboot/uboot-imx-rel_imx_4.1.15_2.1.0/board/freescale/mx6ull_sen_emmc/Kconfig
```kconfig
if TARGET_MX6ULL_SEN_EMMC

config SYS_BOARD
	default "mx6ull_sen_emmc"

config SYS_VENDOR
	default "freescale"

config SYS_CONFIG_NAME
	default "mx6ull_sen_emmc"

endif
```
