## system/kernel/Documentation/devicetree/bindings/input/touchscreen/goodix.txt
```
Device tree bindings for Goodix GT9xx series touchscreen controller

Required properties:

 - compatible		: Should be "goodix,gt911"
			 or "goodix,gt9147"
			 or "goodix,gt1151"
			 or "goodix,gt1158"
				 or "goodix,gt9110"
				 or "goodix,gt912"
				 or "goodix,gt927"
				 or "goodix,gt9271"
				 or "goodix,gt928"
				 or "goodix,gt967"
 - reg			: I2C address of the chip. Should be 0x5d or 0x14
 - interrupt-parent	: Interrupt controller to which the chip is connected
 - interrupts		: Interrupt to which the chip is connected

Optional properties:

 - irq-gpios             : Interrupt GPIO, also used for address selection
 - reset-gpios           : Reset GPIO. Provide both GPIO properties to enable
                           the power-on reset and I2C address selection.

The driver reads the chip ID and selects the GT9xx or GT1151/GT1158 config layout.
GPIO reset uses physical levels: RESET low asserts reset, and INT high during
reset selects address 0x14 (INT low selects 0x5d).

Example:

	i2c@00000000 {
		/* ... */

		gt928@5d {
			compatible = "goodix,gt928";
			reg = <0x5d>;
			interrupt-parent = <&gpio>;
			interrupts = <0 0>;
		};

		/* ... */
	};
```

## system/kernel/arch/arm/mach-imx/Kconfig
```kconfig
menuconfig ARCH_MXC
	bool "Freescale i.MX family" if ARCH_MULTI_V7
	select ARCH_REQUIRE_GPIOLIB
	select ARM_CPU_SUSPEND if PM
	select CLKSRC_MMIO
	select GENERIC_IRQ_CHIP
	select PINCTRL
	select PM_OPP if PM
	select SOC_BUS
	select SRAM
	help
	  Support for Freescale MXC/iMX-based family of processors

if ARCH_MXC

config MXC_TZIC
	bool

config MXC_AVIC
	bool

config HAVE_EPIT
	bool

config MXC_USE_EPIT
	bool "Use EPIT instead of GPT"
	depends on HAVE_EPIT
	help
	  Use EPIT as the system timer on systems that have it. Normally you
	  don't have a reason to do so as the EPIT has the same features and
	  uses the same clocks as the GPT. Anyway, on some systems the GPT
	  may be in use for other purposes.

config ARCH_HAS_RNGA
	bool

config HAVE_IMX_RNG
       bool

config HAVE_IMX_ANATOP
	bool

config HAVE_IMX_GPC
	bool
	select PM_GENERIC_DOMAINS if PM

config HAVE_IMX_GPCV2
	bool
	select PM_GENERIC_DOMAINS if PM

config HAVE_IMX_MMDC
	bool

config HAVE_IMX_AMP
	bool

config HAVE_IMX_DDRC
	bool

config HAVE_IMX_MU
	bool

config HAVE_IMX_RPMSG
	bool

config HAVE_IMX_SRC
	def_bool y if SMP
	select ARCH_HAS_RESET_CONTROLLER

config IMX_HAVE_IOMUX_V1
	bool

config ARCH_MXC_IOMUX_V3
	bool

if ARCH_MULTI_V7

config SOC_IMX6
	bool
	select ARM_ERRATA_754322
	select ARM_ERRATA_775420
	select ARM_GIC
	select HAVE_IMX_ANATOP
	select HAVE_IMX_GPC
	select HAVE_IMX_MMDC
	select HAVE_IMX_SRC
	select MFD_SYSCON
	select HAVE_ARM_SCU if SMP
	select HAVE_ARM_TWD if SMP
	select PL310_ERRATA_769419 if CACHE_L2X0

config SOC_IMX6UL
	bool "i.MX6 UltraLite support"
	select PINCTRL_IMX6UL
	select SOC_IMX6
	select KEYBOARD_SNVS_PWRKEY
	select ARM_ERRATA_814220

	help
	  This enables support for Freescale i.MX6 UltraLite processor.

config SOC_IMX6ULL
	bool "i.MX6 ULL support"
	select SOC_IMX6UL

	help
	  This enables support for Freescale i.MX6 ULL processor.

endif

source "arch/arm/mach-imx/devices/Kconfig"

endif
```

## uboot/arch/arm/Kconfig
```kconfig
menu "ARM architecture"
	depends on ARM

config SYS_ARCH
	default "arm"

config ARM64
	bool

config HAS_VBAR
	bool

config HAS_THUMB2
	bool

config CPU_V7
	bool
	select HAS_VBAR
	select HAS_THUMB2

config SYS_CPU
	default "armv7" if CPU_V7

config SEMIHOSTING
	bool "support boot from semihosting"
	help
	  In emulated environments, semihosting is a way for
	  the hosted environment to call out to the emulator to
	  retrieve files from the host machine.

config SYS_L2CACHE_OFF
	bool "L2cache off"
	help
	  If SoC does not support L2CACHE or one do not want to enable
	  L2CACHE, choose this option.

choice
	prompt "Target select"
	default ARCH_MX6

config ARCH_MX6
	bool "Freescale MX6"
	select CPU_V7

endchoice

source "arch/arm/cpu/armv7/mx6/Kconfig"
source "arch/arm/cpu/armv7/Kconfig"
source "arch/arm/imx-common/Kconfig"
source "arch/arm/Kconfig.debug"

endmenu
```

## uboot/arch/arm/cpu/armv7/mx6/Kconfig
```kconfig
if ARCH_MX6

config MX6
	bool
	default y

# i.MX6ULL shares the i.MX6UL register layout and common code.
config MX6UL
	select SYS_L2CACHE_OFF
	select ROM_UNIFIED_SECTIONS
	bool

config MX6ULL
	bool
	select MX6UL

choice
	prompt "MX6 board select"
	optional

config TARGET_MX6ULL_SEN_EMMC
	bool "Support mx6ull_sen_emmc"
	select MX6ULL
	select DM
	select DM_THERMAL

endchoice

config SYS_SOC
	default "mx6"

source "board/freescale/mx6ull_sen_emmc/Kconfig"

endif
```
